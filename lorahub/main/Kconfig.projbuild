## lorahub/main/Kconfig.projbuild
```kconfig
menu "LoRaWAN one-channel hub config"

menu "Hardware Configuration"

    choice GATEWAY_HW_BOARD
        prompt "Board type"
        default HELTEC_WIFI_LORA_32_V3
        help
            Select the hardware board on which the LoRaHub is run (Semtech DevKit, Heltec WiFi LoRa 32 v3, ...).
        config SEMTECH_DEVKIT
            bool "Semtech DevKit"
            help
                Select Semtech DevKit.
        config EBYTES_ESP32_LR1121
            bool "EBytes ESP32 LR1121"
            help
                Select EBytes ESP32+LR1121.
        config HELTEC_WIFI_LORA_32_V3
            bool "Heltec WiFi LoRa 32 v3"
            help
                Select Heltec WiFi LoRa 32 v3.
        config SEEED_XIAO_ESP32S3_DEVKIT
            bool "Seeed Xiao ESP32S3"
            help
                Select Seeed Xiao ESP32S3.
        config LILYGO_T3S3_LORA32
            bool "Lilygo T3S3 LoRa32"
            help
                Select Lilygo T3S3 LoRa32.
    endchoice

	choice RADIO_TYPE
		prompt "LoRa radio type"
		default RADIO_TYPE_SX1262 if HELTEC_WIFI_LORA_32_V3
		help
			Select the radio type used by the LoRaHub (sx1261, sx1262, sx1268, llcc68, lr1121).

		config RADIO_TYPE_SX1261
			bool "sx1261"
			help
				Select sx1261 radio.

		config RADIO_TYPE_SX1262
			bool "sx1262"
			help
				Select sx1262 radio.

		config RADIO_TYPE_SX1268
			bool "sx1268"
			help
				Select sx1268 radio.

		config RADIO_TYPE_LLCC68
			bool "llcc68"
			help
				Select llcc68 radio.

		config RADIO_TYPE_LR1121
			bool "lr1121"
			help
				Select lr1121 radio.
	endchoice

    config GATEWAY_DISPLAY
        bool "OLED Display"
        default y
        help
            Is there an OLED display connected ?

endmenu # Hardware Configuration

menu "Packet Forwarder Configuration"

    config GATEWAY_ID_AUTO
        bool "Gateway_ID AUTO"
        default y
        help
            Gateway ID automatically set based on MAC address.

    if !GATEWAY_ID_AUTO
        config GATEWAY_ID_CUSTOM
            string "User defined Gateway ID"
            help
                Set Gateway ID. Hex string, 8 bytes.
    endif # GATEWAY_ID_AUTO

    config GET_CFG_FROM_FLASH
        bool "Get config from flash in priority"
        default y
        help
            Get gateway configuration from NVS flash for existing fields.

    config CHANNEL_FREQ_HZ
        int "Channel frequency in Hertz"
        default 868100000
        range 150000000 2500000000
        help
            Set frequency to use [Hz].

    config CHANNEL_LORA_SPREADING_FACTOR_1
        int "Channel LoRa Spreading Factor 1"
        default 7
        range 5 12
        help
            Set LoRa channel first spreading factor [5..12].

    config CHANNEL_LORA_SPREADING_FACTOR_2
        int "Channel LoRa Spreading Factor 2 (LR1121 only)"
        default 0
        range 0 12
        help
            Set LoRa channel second spreading factor, 0 to disable, or [5..12].

    config CHANNEL_LORA_BANDWIDTH
        int "Channel LoRa bandwidth in kHz"
        default 125
        range 125 800
        help
            Set LoRa channel bandwidth (125, 250, 500, 200, 400, 800) kHz.

    config NETWORK_SERVER_ADDRESS
        string "LoRaWAN network server URL or IP address"
        default "eu1.cloud.thethings.network"
        help
            Set the LoRaWAN network server address URL or IP.

    config NETWORK_SERVER_PORT
        int "LoRaWAN network server port"
        default 1700
        help
            Set the LoRaWAN network server port.

    config SNTP_SERVER_ADDRESS
        string "URL or IP address of the SNTP server"
        default "pool.ntp.org"
        help
            Set the SNTP server address URL or IP.

endmenu # Packet Forwarder Configuration

menu "WiFi Configuration"

    config WIFI_CONNECT_MAXIMUM_RETRY
        int "Maximum number of attempts to connect to the configured WiFi"
        default 10
        range 0 255
        help
            Set the Maximum retry to avoid station reconnecting to the AP unlimited when the AP is really inexistent.

    config WIFI_PROV_OVER_BLE
        bool "Enable WiFi provisionning over BLE"
        default y
        help
            The Gateway will initiate WiFi provisioning over BLE.

    if WIFI_PROV_OVER_BLE
        config WIFI_PROV_DELAY_S
            int  "WiFi provisioning delay (s)"
            default 5
            range 0 255
            help
                Waiting period at startup for the user to activate WiFi provisioning mode (in seconds).
    endif # WIFI_PROV_OVER_BLE

    if !WIFI_PROV_OVER_BLE
        config WIFI_SSID
            string  "WiFi SSID"
            default "my-ssid"
            help
                WiFi credentials SSID.
        config WIFI_PASSWORD
            string  "WiFi password"
            default "my-password"
            help
                WiFi credentials password.
    endif # WIFI_PROV_OVER_BLE

endmenu # WiFi Configuration

endmenu # LoRa 1-CH HUB Configuration
```
